;
; File Name: cyfitterrv.inc
; 
; PSoC Creator  4.1 Update 1
;
; Description:
; 
;
;-------------------------------------------------------------------------------
; Copyright (c) 2007-2017 Cypress Semiconductor.  All rights reserved.
; You may use this file only in accordance with the license, terms, conditions, 
; disclaimers, and limitations in the end user license agreement accompanying 
; the software package with which this file was provided.
;-------------------------------------------------------------------------------

    IF :LNOT::DEF:INCLUDED_CYFITTERRV_INC
INCLUDED_CYFITTERRV_INC EQU 1
    GET cydevicerv.inc
    GET cydevicerv_trm.inc

; BUSY_PIN
BUSY_PIN__0__INTTYPE EQU CYREG_PICU0_INTTYPE6
BUSY_PIN__0__MASK EQU 0x40
BUSY_PIN__0__PC EQU CYREG_PRT0_PC6
BUSY_PIN__0__PORT EQU 0
BUSY_PIN__0__SHIFT EQU 6
BUSY_PIN__AG EQU CYREG_PRT0_AG
BUSY_PIN__AMUX EQU CYREG_PRT0_AMUX
BUSY_PIN__BIE EQU CYREG_PRT0_BIE
BUSY_PIN__BIT_MASK EQU CYREG_PRT0_BIT_MASK
BUSY_PIN__BYP EQU CYREG_PRT0_BYP
BUSY_PIN__CTL EQU CYREG_PRT0_CTL
BUSY_PIN__DM0 EQU CYREG_PRT0_DM0
BUSY_PIN__DM1 EQU CYREG_PRT0_DM1
BUSY_PIN__DM2 EQU CYREG_PRT0_DM2
BUSY_PIN__DR EQU CYREG_PRT0_DR
BUSY_PIN__INP_DIS EQU CYREG_PRT0_INP_DIS
BUSY_PIN__INTTYPE_BASE EQU CYDEV_PICU_INTTYPE_PICU0_BASE
BUSY_PIN__LCD_COM_SEG EQU CYREG_PRT0_LCD_COM_SEG
BUSY_PIN__LCD_EN EQU CYREG_PRT0_LCD_EN
BUSY_PIN__MASK EQU 0x40
BUSY_PIN__PORT EQU 0
BUSY_PIN__PRT EQU CYREG_PRT0_PRT
BUSY_PIN__PRTDSI__CAPS_SEL EQU CYREG_PRT0_CAPS_SEL
BUSY_PIN__PRTDSI__DBL_SYNC_IN EQU CYREG_PRT0_DBL_SYNC_IN
BUSY_PIN__PRTDSI__OE_SEL0 EQU CYREG_PRT0_OE_SEL0
BUSY_PIN__PRTDSI__OE_SEL1 EQU CYREG_PRT0_OE_SEL1
BUSY_PIN__PRTDSI__OUT_SEL0 EQU CYREG_PRT0_OUT_SEL0
BUSY_PIN__PRTDSI__OUT_SEL1 EQU CYREG_PRT0_OUT_SEL1
BUSY_PIN__PRTDSI__SYNC_OUT EQU CYREG_PRT0_SYNC_OUT
BUSY_PIN__PS EQU CYREG_PRT0_PS
BUSY_PIN__SHIFT EQU 6
BUSY_PIN__SLW EQU CYREG_PRT0_SLW

; COLLISION_PIN
COLLISION_PIN__0__INTTYPE EQU CYREG_PICU0_INTTYPE5
COLLISION_PIN__0__MASK EQU 0x20
COLLISION_PIN__0__PC EQU CYREG_PRT0_PC5
COLLISION_PIN__0__PORT EQU 0
COLLISION_PIN__0__SHIFT EQU 5
COLLISION_PIN__AG EQU CYREG_PRT0_AG
COLLISION_PIN__AMUX EQU CYREG_PRT0_AMUX
COLLISION_PIN__BIE EQU CYREG_PRT0_BIE
COLLISION_PIN__BIT_MASK EQU CYREG_PRT0_BIT_MASK
COLLISION_PIN__BYP EQU CYREG_PRT0_BYP
COLLISION_PIN__CTL EQU CYREG_PRT0_CTL
COLLISION_PIN__DM0 EQU CYREG_PRT0_DM0
COLLISION_PIN__DM1 EQU CYREG_PRT0_DM1
COLLISION_PIN__DM2 EQU CYREG_PRT0_DM2
COLLISION_PIN__DR EQU CYREG_PRT0_DR
COLLISION_PIN__INP_DIS EQU CYREG_PRT0_INP_DIS
COLLISION_PIN__INTTYPE_BASE EQU CYDEV_PICU_INTTYPE_PICU0_BASE
COLLISION_PIN__LCD_COM_SEG EQU CYREG_PRT0_LCD_COM_SEG
COLLISION_PIN__LCD_EN EQU CYREG_PRT0_LCD_EN
COLLISION_PIN__MASK EQU 0x20
COLLISION_PIN__PORT EQU 0
COLLISION_PIN__PRT EQU CYREG_PRT0_PRT
COLLISION_PIN__PRTDSI__CAPS_SEL EQU CYREG_PRT0_CAPS_SEL
COLLISION_PIN__PRTDSI__DBL_SYNC_IN EQU CYREG_PRT0_DBL_SYNC_IN
COLLISION_PIN__PRTDSI__OE_SEL0 EQU CYREG_PRT0_OE_SEL0
COLLISION_PIN__PRTDSI__OE_SEL1 EQU CYREG_PRT0_OE_SEL1
COLLISION_PIN__PRTDSI__OUT_SEL0 EQU CYREG_PRT0_OUT_SEL0
COLLISION_PIN__PRTDSI__OUT_SEL1 EQU CYREG_PRT0_OUT_SEL1
COLLISION_PIN__PRTDSI__SYNC_OUT EQU CYREG_PRT0_SYNC_OUT
COLLISION_PIN__PS EQU CYREG_PRT0_PS
COLLISION_PIN__SHIFT EQU 5
COLLISION_PIN__SLW EQU CYREG_PRT0_SLW

; IDLE_PIN
IDLE_PIN__0__INTTYPE EQU CYREG_PICU0_INTTYPE7
IDLE_PIN__0__MASK EQU 0x80
IDLE_PIN__0__PC EQU CYREG_PRT0_PC7
IDLE_PIN__0__PORT EQU 0
IDLE_PIN__0__SHIFT EQU 7
IDLE_PIN__AG EQU CYREG_PRT0_AG
IDLE_PIN__AMUX EQU CYREG_PRT0_AMUX
IDLE_PIN__BIE EQU CYREG_PRT0_BIE
IDLE_PIN__BIT_MASK EQU CYREG_PRT0_BIT_MASK
IDLE_PIN__BYP EQU CYREG_PRT0_BYP
IDLE_PIN__CTL EQU CYREG_PRT0_CTL
IDLE_PIN__DM0 EQU CYREG_PRT0_DM0
IDLE_PIN__DM1 EQU CYREG_PRT0_DM1
IDLE_PIN__DM2 EQU CYREG_PRT0_DM2
IDLE_PIN__DR EQU CYREG_PRT0_DR
IDLE_PIN__INP_DIS EQU CYREG_PRT0_INP_DIS
IDLE_PIN__INTTYPE_BASE EQU CYDEV_PICU_INTTYPE_PICU0_BASE
IDLE_PIN__LCD_COM_SEG EQU CYREG_PRT0_LCD_COM_SEG
IDLE_PIN__LCD_EN EQU CYREG_PRT0_LCD_EN
IDLE_PIN__MASK EQU 0x80
IDLE_PIN__PORT EQU 0
IDLE_PIN__PRT EQU CYREG_PRT0_PRT
IDLE_PIN__PRTDSI__CAPS_SEL EQU CYREG_PRT0_CAPS_SEL
IDLE_PIN__PRTDSI__DBL_SYNC_IN EQU CYREG_PRT0_DBL_SYNC_IN
IDLE_PIN__PRTDSI__OE_SEL0 EQU CYREG_PRT0_OE_SEL0
IDLE_PIN__PRTDSI__OE_SEL1 EQU CYREG_PRT0_OE_SEL1
IDLE_PIN__PRTDSI__OUT_SEL0 EQU CYREG_PRT0_OUT_SEL0
IDLE_PIN__PRTDSI__OUT_SEL1 EQU CYREG_PRT0_OUT_SEL1
IDLE_PIN__PRTDSI__SYNC_OUT EQU CYREG_PRT0_SYNC_OUT
IDLE_PIN__PS EQU CYREG_PRT0_PS
IDLE_PIN__SHIFT EQU 7
IDLE_PIN__SLW EQU CYREG_PRT0_SLW

; RECEIVE
RECEIVE__0__INTTYPE EQU CYREG_PICU3_INTTYPE7
RECEIVE__0__MASK EQU 0x80
RECEIVE__0__PC EQU CYREG_PRT3_PC7
RECEIVE__0__PORT EQU 3
RECEIVE__0__SHIFT EQU 7
RECEIVE__AG EQU CYREG_PRT3_AG
RECEIVE__AMUX EQU CYREG_PRT3_AMUX
RECEIVE__BIE EQU CYREG_PRT3_BIE
RECEIVE__BIT_MASK EQU CYREG_PRT3_BIT_MASK
RECEIVE__BYP EQU CYREG_PRT3_BYP
RECEIVE__CTL EQU CYREG_PRT3_CTL
RECEIVE__DM0 EQU CYREG_PRT3_DM0
RECEIVE__DM1 EQU CYREG_PRT3_DM1
RECEIVE__DM2 EQU CYREG_PRT3_DM2
RECEIVE__DR EQU CYREG_PRT3_DR
RECEIVE__INP_DIS EQU CYREG_PRT3_INP_DIS
RECEIVE__INTSTAT EQU CYREG_PICU3_INTSTAT
RECEIVE__INTTYPE_BASE EQU CYDEV_PICU_INTTYPE_PICU3_BASE
RECEIVE__LCD_COM_SEG EQU CYREG_PRT3_LCD_COM_SEG
RECEIVE__LCD_EN EQU CYREG_PRT3_LCD_EN
RECEIVE__MASK EQU 0x80
RECEIVE__PORT EQU 3
RECEIVE__PRT EQU CYREG_PRT3_PRT
RECEIVE__PRTDSI__CAPS_SEL EQU CYREG_PRT3_CAPS_SEL
RECEIVE__PRTDSI__DBL_SYNC_IN EQU CYREG_PRT3_DBL_SYNC_IN
RECEIVE__PRTDSI__OE_SEL0 EQU CYREG_PRT3_OE_SEL0
RECEIVE__PRTDSI__OE_SEL1 EQU CYREG_PRT3_OE_SEL1
RECEIVE__PRTDSI__OUT_SEL0 EQU CYREG_PRT3_OUT_SEL0
RECEIVE__PRTDSI__OUT_SEL1 EQU CYREG_PRT3_OUT_SEL1
RECEIVE__PRTDSI__SYNC_OUT EQU CYREG_PRT3_SYNC_OUT
RECEIVE__PS EQU CYREG_PRT3_PS
RECEIVE__SHIFT EQU 7
RECEIVE__SLW EQU CYREG_PRT3_SLW
RECEIVE__SNAP EQU CYREG_PICU3_SNAP

; RX_INTERRUPT
RX_INTERRUPT__INTC_CLR_EN_REG EQU CYREG_NVIC_CLRENA0
RX_INTERRUPT__INTC_CLR_PD_REG EQU CYREG_NVIC_CLRPEND0
RX_INTERRUPT__INTC_MASK EQU 0x80
RX_INTERRUPT__INTC_NUMBER EQU 7
RX_INTERRUPT__INTC_PRIOR_NUM EQU 7
RX_INTERRUPT__INTC_PRIOR_REG EQU CYREG_NVIC_PRI_7
RX_INTERRUPT__INTC_SET_EN_REG EQU CYREG_NVIC_SETENA0
RX_INTERRUPT__INTC_SET_PD_REG EQU CYREG_NVIC_SETPEND0

; TIMER_INTERRUPT
TIMER_INTERRUPT__INTC_CLR_EN_REG EQU CYREG_NVIC_CLRENA0
TIMER_INTERRUPT__INTC_CLR_PD_REG EQU CYREG_NVIC_CLRPEND0
TIMER_INTERRUPT__INTC_MASK EQU 0x01
TIMER_INTERRUPT__INTC_NUMBER EQU 0
TIMER_INTERRUPT__INTC_PRIOR_NUM EQU 7
TIMER_INTERRUPT__INTC_PRIOR_REG EQU CYREG_NVIC_PRI_0
TIMER_INTERRUPT__INTC_SET_EN_REG EQU CYREG_NVIC_SETENA0
TIMER_INTERRUPT__INTC_SET_PD_REG EQU CYREG_NVIC_SETPEND0

; TIMER_TimerUDB
TIMER_TimerUDB_rstSts_stsreg__0__MASK EQU 0x01
TIMER_TimerUDB_rstSts_stsreg__0__POS EQU 0
TIMER_TimerUDB_rstSts_stsreg__16BIT_STATUS_AUX_CTL_REG EQU CYREG_B0_UDB11_12_ACTL
TIMER_TimerUDB_rstSts_stsreg__16BIT_STATUS_REG EQU CYREG_B0_UDB11_12_ST
TIMER_TimerUDB_rstSts_stsreg__2__MASK EQU 0x04
TIMER_TimerUDB_rstSts_stsreg__2__POS EQU 2
TIMER_TimerUDB_rstSts_stsreg__3__MASK EQU 0x08
TIMER_TimerUDB_rstSts_stsreg__3__POS EQU 3
TIMER_TimerUDB_rstSts_stsreg__MASK EQU 0x0D
TIMER_TimerUDB_rstSts_stsreg__MASK_REG EQU CYREG_B0_UDB11_MSK
TIMER_TimerUDB_rstSts_stsreg__STATUS_AUX_CTL_REG EQU CYREG_B0_UDB11_ACTL
TIMER_TimerUDB_rstSts_stsreg__STATUS_REG EQU CYREG_B0_UDB11_ST
TIMER_TimerUDB_sCTRLReg_SyncCtl_ctrlreg__16BIT_CONTROL_AUX_CTL_REG EQU CYREG_B0_UDB09_10_ACTL
TIMER_TimerUDB_sCTRLReg_SyncCtl_ctrlreg__16BIT_CONTROL_CONTROL_REG EQU CYREG_B0_UDB09_10_CTL
TIMER_TimerUDB_sCTRLReg_SyncCtl_ctrlreg__16BIT_CONTROL_COUNT_REG EQU CYREG_B0_UDB09_10_CTL
TIMER_TimerUDB_sCTRLReg_SyncCtl_ctrlreg__16BIT_COUNT_CONTROL_REG EQU CYREG_B0_UDB09_10_CTL
TIMER_TimerUDB_sCTRLReg_SyncCtl_ctrlreg__16BIT_COUNT_COUNT_REG EQU CYREG_B0_UDB09_10_CTL
TIMER_TimerUDB_sCTRLReg_SyncCtl_ctrlreg__16BIT_MASK_MASK_REG EQU CYREG_B0_UDB09_10_MSK
TIMER_TimerUDB_sCTRLReg_SyncCtl_ctrlreg__16BIT_MASK_PERIOD_REG EQU CYREG_B0_UDB09_10_MSK
TIMER_TimerUDB_sCTRLReg_SyncCtl_ctrlreg__16BIT_PERIOD_MASK_REG EQU CYREG_B0_UDB09_10_MSK
TIMER_TimerUDB_sCTRLReg_SyncCtl_ctrlreg__16BIT_PERIOD_PERIOD_REG EQU CYREG_B0_UDB09_10_MSK
TIMER_TimerUDB_sCTRLReg_SyncCtl_ctrlreg__7__MASK EQU 0x80
TIMER_TimerUDB_sCTRLReg_SyncCtl_ctrlreg__7__POS EQU 7
TIMER_TimerUDB_sCTRLReg_SyncCtl_ctrlreg__CONTROL_AUX_CTL_REG EQU CYREG_B0_UDB09_ACTL
TIMER_TimerUDB_sCTRLReg_SyncCtl_ctrlreg__CONTROL_REG EQU CYREG_B0_UDB09_CTL
TIMER_TimerUDB_sCTRLReg_SyncCtl_ctrlreg__CONTROL_ST_REG EQU CYREG_B0_UDB09_ST_CTL
TIMER_TimerUDB_sCTRLReg_SyncCtl_ctrlreg__COUNT_REG EQU CYREG_B0_UDB09_CTL
TIMER_TimerUDB_sCTRLReg_SyncCtl_ctrlreg__COUNT_ST_REG EQU CYREG_B0_UDB09_ST_CTL
TIMER_TimerUDB_sCTRLReg_SyncCtl_ctrlreg__MASK EQU 0x80
TIMER_TimerUDB_sCTRLReg_SyncCtl_ctrlreg__MASK_CTL_AUX_CTL_REG EQU CYREG_B0_UDB09_MSK_ACTL
TIMER_TimerUDB_sCTRLReg_SyncCtl_ctrlreg__PER_CTL_AUX_CTL_REG EQU CYREG_B0_UDB09_MSK_ACTL
TIMER_TimerUDB_sCTRLReg_SyncCtl_ctrlreg__PERIOD_REG EQU CYREG_B0_UDB09_MSK
TIMER_TimerUDB_sT32_timerdp_u0__16BIT_A0_REG EQU CYREG_B0_UDB08_09_A0
TIMER_TimerUDB_sT32_timerdp_u0__16BIT_A1_REG EQU CYREG_B0_UDB08_09_A1
TIMER_TimerUDB_sT32_timerdp_u0__16BIT_D0_REG EQU CYREG_B0_UDB08_09_D0
TIMER_TimerUDB_sT32_timerdp_u0__16BIT_D1_REG EQU CYREG_B0_UDB08_09_D1
TIMER_TimerUDB_sT32_timerdp_u0__16BIT_DP_AUX_CTL_REG EQU CYREG_B0_UDB08_09_ACTL
TIMER_TimerUDB_sT32_timerdp_u0__16BIT_F0_REG EQU CYREG_B0_UDB08_09_F0
TIMER_TimerUDB_sT32_timerdp_u0__16BIT_F1_REG EQU CYREG_B0_UDB08_09_F1
TIMER_TimerUDB_sT32_timerdp_u0__A0_A1_REG EQU CYREG_B0_UDB08_A0_A1
TIMER_TimerUDB_sT32_timerdp_u0__A0_REG EQU CYREG_B0_UDB08_A0
TIMER_TimerUDB_sT32_timerdp_u0__A1_REG EQU CYREG_B0_UDB08_A1
TIMER_TimerUDB_sT32_timerdp_u0__D0_D1_REG EQU CYREG_B0_UDB08_D0_D1
TIMER_TimerUDB_sT32_timerdp_u0__D0_REG EQU CYREG_B0_UDB08_D0
TIMER_TimerUDB_sT32_timerdp_u0__D1_REG EQU CYREG_B0_UDB08_D1
TIMER_TimerUDB_sT32_timerdp_u0__DP_AUX_CTL_REG EQU CYREG_B0_UDB08_ACTL
TIMER_TimerUDB_sT32_timerdp_u0__F0_F1_REG EQU CYREG_B0_UDB08_F0_F1
TIMER_TimerUDB_sT32_timerdp_u0__F0_REG EQU CYREG_B0_UDB08_F0
TIMER_TimerUDB_sT32_timerdp_u0__F1_REG EQU CYREG_B0_UDB08_F1
TIMER_TimerUDB_sT32_timerdp_u1__16BIT_A0_REG EQU CYREG_B0_UDB09_10_A0
TIMER_TimerUDB_sT32_timerdp_u1__16BIT_A1_REG EQU CYREG_B0_UDB09_10_A1
TIMER_TimerUDB_sT32_timerdp_u1__16BIT_D0_REG EQU CYREG_B0_UDB09_10_D0
TIMER_TimerUDB_sT32_timerdp_u1__16BIT_D1_REG EQU CYREG_B0_UDB09_10_D1
TIMER_TimerUDB_sT32_timerdp_u1__16BIT_DP_AUX_CTL_REG EQU CYREG_B0_UDB09_10_ACTL
TIMER_TimerUDB_sT32_timerdp_u1__16BIT_F0_REG EQU CYREG_B0_UDB09_10_F0
TIMER_TimerUDB_sT32_timerdp_u1__16BIT_F1_REG EQU CYREG_B0_UDB09_10_F1
TIMER_TimerUDB_sT32_timerdp_u1__A0_A1_REG EQU CYREG_B0_UDB09_A0_A1
TIMER_TimerUDB_sT32_timerdp_u1__A0_REG EQU CYREG_B0_UDB09_A0
TIMER_TimerUDB_sT32_timerdp_u1__A1_REG EQU CYREG_B0_UDB09_A1
TIMER_TimerUDB_sT32_timerdp_u1__D0_D1_REG EQU CYREG_B0_UDB09_D0_D1
TIMER_TimerUDB_sT32_timerdp_u1__D0_REG EQU CYREG_B0_UDB09_D0
TIMER_TimerUDB_sT32_timerdp_u1__D1_REG EQU CYREG_B0_UDB09_D1
TIMER_TimerUDB_sT32_timerdp_u1__DP_AUX_CTL_REG EQU CYREG_B0_UDB09_ACTL
TIMER_TimerUDB_sT32_timerdp_u1__F0_F1_REG EQU CYREG_B0_UDB09_F0_F1
TIMER_TimerUDB_sT32_timerdp_u1__F0_REG EQU CYREG_B0_UDB09_F0
TIMER_TimerUDB_sT32_timerdp_u1__F1_REG EQU CYREG_B0_UDB09_F1
TIMER_TimerUDB_sT32_timerdp_u1__MSK_DP_AUX_CTL_REG EQU CYREG_B0_UDB09_MSK_ACTL
TIMER_TimerUDB_sT32_timerdp_u1__PER_DP_AUX_CTL_REG EQU CYREG_B0_UDB09_MSK_ACTL
TIMER_TimerUDB_sT32_timerdp_u2__16BIT_A0_REG EQU CYREG_B0_UDB10_11_A0
TIMER_TimerUDB_sT32_timerdp_u2__16BIT_A1_REG EQU CYREG_B0_UDB10_11_A1
TIMER_TimerUDB_sT32_timerdp_u2__16BIT_D0_REG EQU CYREG_B0_UDB10_11_D0
TIMER_TimerUDB_sT32_timerdp_u2__16BIT_D1_REG EQU CYREG_B0_UDB10_11_D1
TIMER_TimerUDB_sT32_timerdp_u2__16BIT_DP_AUX_CTL_REG EQU CYREG_B0_UDB10_11_ACTL
TIMER_TimerUDB_sT32_timerdp_u2__16BIT_F0_REG EQU CYREG_B0_UDB10_11_F0
TIMER_TimerUDB_sT32_timerdp_u2__16BIT_F1_REG EQU CYREG_B0_UDB10_11_F1
TIMER_TimerUDB_sT32_timerdp_u2__A0_A1_REG EQU CYREG_B0_UDB10_A0_A1
TIMER_TimerUDB_sT32_timerdp_u2__A0_REG EQU CYREG_B0_UDB10_A0
TIMER_TimerUDB_sT32_timerdp_u2__A1_REG EQU CYREG_B0_UDB10_A1
TIMER_TimerUDB_sT32_timerdp_u2__D0_D1_REG EQU CYREG_B0_UDB10_D0_D1
TIMER_TimerUDB_sT32_timerdp_u2__D0_REG EQU CYREG_B0_UDB10_D0
TIMER_TimerUDB_sT32_timerdp_u2__D1_REG EQU CYREG_B0_UDB10_D1
TIMER_TimerUDB_sT32_timerdp_u2__DP_AUX_CTL_REG EQU CYREG_B0_UDB10_ACTL
TIMER_TimerUDB_sT32_timerdp_u2__F0_F1_REG EQU CYREG_B0_UDB10_F0_F1
TIMER_TimerUDB_sT32_timerdp_u2__F0_REG EQU CYREG_B0_UDB10_F0
TIMER_TimerUDB_sT32_timerdp_u2__F1_REG EQU CYREG_B0_UDB10_F1
TIMER_TimerUDB_sT32_timerdp_u3__16BIT_A0_REG EQU CYREG_B0_UDB11_12_A0
TIMER_TimerUDB_sT32_timerdp_u3__16BIT_A1_REG EQU CYREG_B0_UDB11_12_A1
TIMER_TimerUDB_sT32_timerdp_u3__16BIT_D0_REG EQU CYREG_B0_UDB11_12_D0
TIMER_TimerUDB_sT32_timerdp_u3__16BIT_D1_REG EQU CYREG_B0_UDB11_12_D1
TIMER_TimerUDB_sT32_timerdp_u3__16BIT_DP_AUX_CTL_REG EQU CYREG_B0_UDB11_12_ACTL
TIMER_TimerUDB_sT32_timerdp_u3__16BIT_F0_REG EQU CYREG_B0_UDB11_12_F0
TIMER_TimerUDB_sT32_timerdp_u3__16BIT_F1_REG EQU CYREG_B0_UDB11_12_F1
TIMER_TimerUDB_sT32_timerdp_u3__A0_A1_REG EQU CYREG_B0_UDB11_A0_A1
TIMER_TimerUDB_sT32_timerdp_u3__A0_REG EQU CYREG_B0_UDB11_A0
TIMER_TimerUDB_sT32_timerdp_u3__A1_REG EQU CYREG_B0_UDB11_A1
TIMER_TimerUDB_sT32_timerdp_u3__D0_D1_REG EQU CYREG_B0_UDB11_D0_D1
TIMER_TimerUDB_sT32_timerdp_u3__D0_REG EQU CYREG_B0_UDB11_D0
TIMER_TimerUDB_sT32_timerdp_u3__D1_REG EQU CYREG_B0_UDB11_D1
TIMER_TimerUDB_sT32_timerdp_u3__DP_AUX_CTL_REG EQU CYREG_B0_UDB11_ACTL
TIMER_TimerUDB_sT32_timerdp_u3__F0_F1_REG EQU CYREG_B0_UDB11_F0_F1
TIMER_TimerUDB_sT32_timerdp_u3__F0_REG EQU CYREG_B0_UDB11_F0
TIMER_TimerUDB_sT32_timerdp_u3__F1_REG EQU CYREG_B0_UDB11_F1

; TX_PIN
TX_PIN__0__INTTYPE EQU CYREG_PICU0_INTTYPE4
TX_PIN__0__MASK EQU 0x10
TX_PIN__0__PC EQU CYREG_PRT0_PC4
TX_PIN__0__PORT EQU 0
TX_PIN__0__SHIFT EQU 4
TX_PIN__AG EQU CYREG_PRT0_AG
TX_PIN__AMUX EQU CYREG_PRT0_AMUX
TX_PIN__BIE EQU CYREG_PRT0_BIE
TX_PIN__BIT_MASK EQU CYREG_PRT0_BIT_MASK
TX_PIN__BYP EQU CYREG_PRT0_BYP
TX_PIN__CTL EQU CYREG_PRT0_CTL
TX_PIN__DM0 EQU CYREG_PRT0_DM0
TX_PIN__DM1 EQU CYREG_PRT0_DM1
TX_PIN__DM2 EQU CYREG_PRT0_DM2
TX_PIN__DR EQU CYREG_PRT0_DR
TX_PIN__INP_DIS EQU CYREG_PRT0_INP_DIS
TX_PIN__INTTYPE_BASE EQU CYDEV_PICU_INTTYPE_PICU0_BASE
TX_PIN__LCD_COM_SEG EQU CYREG_PRT0_LCD_COM_SEG
TX_PIN__LCD_EN EQU CYREG_PRT0_LCD_EN
TX_PIN__MASK EQU 0x10
TX_PIN__PORT EQU 0
TX_PIN__PRT EQU CYREG_PRT0_PRT
TX_PIN__PRTDSI__CAPS_SEL EQU CYREG_PRT0_CAPS_SEL
TX_PIN__PRTDSI__DBL_SYNC_IN EQU CYREG_PRT0_DBL_SYNC_IN
TX_PIN__PRTDSI__OE_SEL0 EQU CYREG_PRT0_OE_SEL0
TX_PIN__PRTDSI__OE_SEL1 EQU CYREG_PRT0_OE_SEL1
TX_PIN__PRTDSI__OUT_SEL0 EQU CYREG_PRT0_OUT_SEL0
TX_PIN__PRTDSI__OUT_SEL1 EQU CYREG_PRT0_OUT_SEL1
TX_PIN__PRTDSI__SYNC_OUT EQU CYREG_PRT0_SYNC_OUT
TX_PIN__PS EQU CYREG_PRT0_PS
TX_PIN__SHIFT EQU 4
TX_PIN__SLW EQU CYREG_PRT0_SLW

; USBUART
USBUART_arb_int__INTC_CLR_EN_REG EQU CYREG_NVIC_CLRENA0
USBUART_arb_int__INTC_CLR_PD_REG EQU CYREG_NVIC_CLRPEND0
USBUART_arb_int__INTC_MASK EQU 0x400000
USBUART_arb_int__INTC_NUMBER EQU 22
USBUART_arb_int__INTC_PRIOR_NUM EQU 7
USBUART_arb_int__INTC_PRIOR_REG EQU CYREG_NVIC_PRI_22
USBUART_arb_int__INTC_SET_EN_REG EQU CYREG_NVIC_SETENA0
USBUART_arb_int__INTC_SET_PD_REG EQU CYREG_NVIC_SETPEND0
USBUART_bus_reset__INTC_CLR_EN_REG EQU CYREG_NVIC_CLRENA0
USBUART_bus_reset__INTC_CLR_PD_REG EQU CYREG_NVIC_CLRPEND0
USBUART_bus_reset__INTC_MASK EQU 0x800000
USBUART_bus_reset__INTC_NUMBER EQU 23
USBUART_bus_reset__INTC_PRIOR_NUM EQU 7
USBUART_bus_reset__INTC_PRIOR_REG EQU CYREG_NVIC_PRI_23
USBUART_bus_reset__INTC_SET_EN_REG EQU CYREG_NVIC_SETENA0
USBUART_bus_reset__INTC_SET_PD_REG EQU CYREG_NVIC_SETPEND0
USBUART_Dm__0__INTTYPE EQU CYREG_PICU15_INTTYPE7
USBUART_Dm__0__MASK EQU 0x80
USBUART_Dm__0__PC EQU CYREG_IO_PC_PRT15_7_6_PC1
USBUART_Dm__0__PORT EQU 15
USBUART_Dm__0__SHIFT EQU 7
USBUART_Dm__AG EQU CYREG_PRT15_AG
USBUART_Dm__AMUX EQU CYREG_PRT15_AMUX
USBUART_Dm__BIE EQU CYREG_PRT15_BIE
USBUART_Dm__BIT_MASK EQU CYREG_PRT15_BIT_MASK
USBUART_Dm__BYP EQU CYREG_PRT15_BYP
USBUART_Dm__CTL EQU CYREG_PRT15_CTL
USBUART_Dm__DM0 EQU CYREG_PRT15_DM0
USBUART_Dm__DM1 EQU CYREG_PRT15_DM1
USBUART_Dm__DM2 EQU CYREG_PRT15_DM2
USBUART_Dm__DR EQU CYREG_PRT15_DR
USBUART_Dm__INP_DIS EQU CYREG_PRT15_INP_DIS
USBUART_Dm__INTTYPE_BASE EQU CYDEV_PICU_INTTYPE_PICU15_BASE
USBUART_Dm__LCD_COM_SEG EQU CYREG_PRT15_LCD_COM_SEG
USBUART_Dm__LCD_EN EQU CYREG_PRT15_LCD_EN
USBUART_Dm__MASK EQU 0x80
USBUART_Dm__PORT EQU 15
USBUART_Dm__PRT EQU CYREG_PRT15_PRT
USBUART_Dm__PRTDSI__CAPS_SEL EQU CYREG_PRT15_CAPS_SEL
USBUART_Dm__PRTDSI__DBL_SYNC_IN EQU CYREG_PRT15_DBL_SYNC_IN
USBUART_Dm__PRTDSI__OE_SEL0 EQU CYREG_PRT15_OE_SEL0
USBUART_Dm__PRTDSI__OE_SEL1 EQU CYREG_PRT15_OE_SEL1
USBUART_Dm__PRTDSI__OUT_SEL0 EQU CYREG_PRT15_OUT_SEL0
USBUART_Dm__PRTDSI__OUT_SEL1 EQU CYREG_PRT15_OUT_SEL1
USBUART_Dm__PRTDSI__SYNC_OUT EQU CYREG_PRT15_SYNC_OUT
USBUART_Dm__PS EQU CYREG_PRT15_PS
USBUART_Dm__SHIFT EQU 7
USBUART_Dm__SLW EQU CYREG_PRT15_SLW
USBUART_Dp__0__INTTYPE EQU CYREG_PICU15_INTTYPE6
USBUART_Dp__0__MASK EQU 0x40
USBUART_Dp__0__PC EQU CYREG_IO_PC_PRT15_7_6_PC0
USBUART_Dp__0__PORT EQU 15
USBUART_Dp__0__SHIFT EQU 6
USBUART_Dp__AG EQU CYREG_PRT15_AG
USBUART_Dp__AMUX EQU CYREG_PRT15_AMUX
USBUART_Dp__BIE EQU CYREG_PRT15_BIE
USBUART_Dp__BIT_MASK EQU CYREG_PRT15_BIT_MASK
USBUART_Dp__BYP EQU CYREG_PRT15_BYP
USBUART_Dp__CTL EQU CYREG_PRT15_CTL
USBUART_Dp__DM0 EQU CYREG_PRT15_DM0
USBUART_Dp__DM1 EQU CYREG_PRT15_DM1
USBUART_Dp__DM2 EQU CYREG_PRT15_DM2
USBUART_Dp__DR EQU CYREG_PRT15_DR
USBUART_Dp__INP_DIS EQU CYREG_PRT15_INP_DIS
USBUART_Dp__INTSTAT EQU CYREG_PICU15_INTSTAT
USBUART_Dp__INTTYPE_BASE EQU CYDEV_PICU_INTTYPE_PICU15_BASE
USBUART_Dp__LCD_COM_SEG EQU CYREG_PRT15_LCD_COM_SEG
USBUART_Dp__LCD_EN EQU CYREG_PRT15_LCD_EN
USBUART_Dp__MASK EQU 0x40
USBUART_Dp__PORT EQU 15
USBUART_Dp__PRT EQU CYREG_PRT15_PRT
USBUART_Dp__PRTDSI__CAPS_SEL EQU CYREG_PRT15_CAPS_SEL
USBUART_Dp__PRTDSI__DBL_SYNC_IN EQU CYREG_PRT15_DBL_SYNC_IN
USBUART_Dp__PRTDSI__OE_SEL0 EQU CYREG_PRT15_OE_SEL0
USBUART_Dp__PRTDSI__OE_SEL1 EQU CYREG_PRT15_OE_SEL1
USBUART_Dp__PRTDSI__OUT_SEL0 EQU CYREG_PRT15_OUT_SEL0
USBUART_Dp__PRTDSI__OUT_SEL1 EQU CYREG_PRT15_OUT_SEL1
USBUART_Dp__PRTDSI__SYNC_OUT EQU CYREG_PRT15_SYNC_OUT
USBUART_Dp__PS EQU CYREG_PRT15_PS
USBUART_Dp__SHIFT EQU 6
USBUART_Dp__SLW EQU CYREG_PRT15_SLW
USBUART_Dp__SNAP EQU CYREG_PICU_15_SNAP_15
USBUART_dp_int__INTC_CLR_EN_REG EQU CYREG_NVIC_CLRENA0
USBUART_dp_int__INTC_CLR_PD_REG EQU CYREG_NVIC_CLRPEND0
USBUART_dp_int__INTC_MASK EQU 0x1000
USBUART_dp_int__INTC_NUMBER EQU 12
USBUART_dp_int__INTC_PRIOR_NUM EQU 7
USBUART_dp_int__INTC_PRIOR_REG EQU CYREG_NVIC_PRI_12
USBUART_dp_int__INTC_SET_EN_REG EQU CYREG_NVIC_SETENA0
USBUART_dp_int__INTC_SET_PD_REG EQU CYREG_NVIC_SETPEND0
USBUART_ep_0__INTC_CLR_EN_REG EQU CYREG_NVIC_CLRENA0
USBUART_ep_0__INTC_CLR_PD_REG EQU CYREG_NVIC_CLRPEND0
USBUART_ep_0__INTC_MASK EQU 0x1000000
USBUART_ep_0__INTC_NUMBER EQU 24
USBUART_ep_0__INTC_PRIOR_NUM EQU 7
USBUART_ep_0__INTC_PRIOR_REG EQU CYREG_NVIC_PRI_24
USBUART_ep_0__INTC_SET_EN_REG EQU CYREG_NVIC_SETENA0
USBUART_ep_0__INTC_SET_PD_REG EQU CYREG_NVIC_SETPEND0
USBUART_ep_1__INTC_CLR_EN_REG EQU CYREG_NVIC_CLRENA0
USBUART_ep_1__INTC_CLR_PD_REG EQU CYREG_NVIC_CLRPEND0
USBUART_ep_1__INTC_MASK EQU 0x02
USBUART_ep_1__INTC_NUMBER EQU 1
USBUART_ep_1__INTC_PRIOR_NUM EQU 7
USBUART_ep_1__INTC_PRIOR_REG EQU CYREG_NVIC_PRI_1
USBUART_ep_1__INTC_SET_EN_REG EQU CYREG_NVIC_SETENA0
USBUART_ep_1__INTC_SET_PD_REG EQU CYREG_NVIC_SETPEND0
USBUART_ep_2__INTC_CLR_EN_REG EQU CYREG_NVIC_CLRENA0
USBUART_ep_2__INTC_CLR_PD_REG EQU CYREG_NVIC_CLRPEND0
USBUART_ep_2__INTC_MASK EQU 0x04
USBUART_ep_2__INTC_NUMBER EQU 2
USBUART_ep_2__INTC_PRIOR_NUM EQU 7
USBUART_ep_2__INTC_PRIOR_REG EQU CYREG_NVIC_PRI_2
USBUART_ep_2__INTC_SET_EN_REG EQU CYREG_NVIC_SETENA0
USBUART_ep_2__INTC_SET_PD_REG EQU CYREG_NVIC_SETPEND0
USBUART_ep_3__INTC_CLR_EN_REG EQU CYREG_NVIC_CLRENA0
USBUART_ep_3__INTC_CLR_PD_REG EQU CYREG_NVIC_CLRPEND0
USBUART_ep_3__INTC_MASK EQU 0x08
USBUART_ep_3__INTC_NUMBER EQU 3
USBUART_ep_3__INTC_PRIOR_NUM EQU 7
USBUART_ep_3__INTC_PRIOR_REG EQU CYREG_NVIC_PRI_3
USBUART_ep_3__INTC_SET_EN_REG EQU CYREG_NVIC_SETENA0
USBUART_ep_3__INTC_SET_PD_REG EQU CYREG_NVIC_SETPEND0
USBUART_sof_int__INTC_CLR_EN_REG EQU CYREG_NVIC_CLRENA0
USBUART_sof_int__INTC_CLR_PD_REG EQU CYREG_NVIC_CLRPEND0
USBUART_sof_int__INTC_MASK EQU 0x200000
USBUART_sof_int__INTC_NUMBER EQU 21
USBUART_sof_int__INTC_PRIOR_NUM EQU 7
USBUART_sof_int__INTC_PRIOR_REG EQU CYREG_NVIC_PRI_21
USBUART_sof_int__INTC_SET_EN_REG EQU CYREG_NVIC_SETENA0
USBUART_sof_int__INTC_SET_PD_REG EQU CYREG_NVIC_SETPEND0
USBUART_USB__ARB_CFG EQU CYREG_USB_ARB_CFG
USBUART_USB__ARB_EP1_CFG EQU CYREG_USB_ARB_EP1_CFG
USBUART_USB__ARB_EP1_INT_EN EQU CYREG_USB_ARB_EP1_INT_EN
USBUART_USB__ARB_EP1_SR EQU CYREG_USB_ARB_EP1_SR
USBUART_USB__ARB_EP2_CFG EQU CYREG_USB_ARB_EP2_CFG
USBUART_USB__ARB_EP2_INT_EN EQU CYREG_USB_ARB_EP2_INT_EN
USBUART_USB__ARB_EP2_SR EQU CYREG_USB_ARB_EP2_SR
USBUART_USB__ARB_EP3_CFG EQU CYREG_USB_ARB_EP3_CFG
USBUART_USB__ARB_EP3_INT_EN EQU CYREG_USB_ARB_EP3_INT_EN
USBUART_USB__ARB_EP3_SR EQU CYREG_USB_ARB_EP3_SR
USBUART_USB__ARB_EP4_CFG EQU CYREG_USB_ARB_EP4_CFG
USBUART_USB__ARB_EP4_INT_EN EQU CYREG_USB_ARB_EP4_INT_EN
USBUART_USB__ARB_EP4_SR EQU CYREG_USB_ARB_EP4_SR
USBUART_USB__ARB_EP5_CFG EQU CYREG_USB_ARB_EP5_CFG
USBUART_USB__ARB_EP5_INT_EN EQU CYREG_USB_ARB_EP5_INT_EN
USBUART_USB__ARB_EP5_SR EQU CYREG_USB_ARB_EP5_SR
USBUART_USB__ARB_EP6_CFG EQU CYREG_USB_ARB_EP6_CFG
USBUART_USB__ARB_EP6_INT_EN EQU CYREG_USB_ARB_EP6_INT_EN
USBUART_USB__ARB_EP6_SR EQU CYREG_USB_ARB_EP6_SR
USBUART_USB__ARB_EP7_CFG EQU CYREG_USB_ARB_EP7_CFG
USBUART_USB__ARB_EP7_INT_EN EQU CYREG_USB_ARB_EP7_INT_EN
USBUART_USB__ARB_EP7_SR EQU CYREG_USB_ARB_EP7_SR
USBUART_USB__ARB_EP8_CFG EQU CYREG_USB_ARB_EP8_CFG
USBUART_USB__ARB_EP8_INT_EN EQU CYREG_USB_ARB_EP8_INT_EN
USBUART_USB__ARB_EP8_SR EQU CYREG_USB_ARB_EP8_SR
USBUART_USB__ARB_INT_EN EQU CYREG_USB_ARB_INT_EN
USBUART_USB__ARB_INT_SR EQU CYREG_USB_ARB_INT_SR
USBUART_USB__ARB_RW1_DR EQU CYREG_USB_ARB_RW1_DR
USBUART_USB__ARB_RW1_RA EQU CYREG_USB_ARB_RW1_RA
USBUART_USB__ARB_RW1_RA_MSB EQU CYREG_USB_ARB_RW1_RA_MSB
USBUART_USB__ARB_RW1_WA EQU CYREG_USB_ARB_RW1_WA
USBUART_USB__ARB_RW1_WA_MSB EQU CYREG_USB_ARB_RW1_WA_MSB
USBUART_USB__ARB_RW2_DR EQU CYREG_USB_ARB_RW2_DR
USBUART_USB__ARB_RW2_RA EQU CYREG_USB_ARB_RW2_RA
USBUART_USB__ARB_RW2_RA_MSB EQU CYREG_USB_ARB_RW2_RA_MSB
USBUART_USB__ARB_RW2_WA EQU CYREG_USB_ARB_RW2_WA
USBUART_USB__ARB_RW2_WA_MSB EQU CYREG_USB_ARB_RW2_WA_MSB
USBUART_USB__ARB_RW3_DR EQU CYREG_USB_ARB_RW3_DR
USBUART_USB__ARB_RW3_RA EQU CYREG_USB_ARB_RW3_RA
USBUART_USB__ARB_RW3_RA_MSB EQU CYREG_USB_ARB_RW3_RA_MSB
USBUART_USB__ARB_RW3_WA EQU CYREG_USB_ARB_RW3_WA
USBUART_USB__ARB_RW3_WA_MSB EQU CYREG_USB_ARB_RW3_WA_MSB
USBUART_USB__ARB_RW4_DR EQU CYREG_USB_ARB_RW4_DR
USBUART_USB__ARB_RW4_RA EQU CYREG_USB_ARB_RW4_RA
USBUART_USB__ARB_RW4_RA_MSB EQU CYREG_USB_ARB_RW4_RA_MSB
USBUART_USB__ARB_RW4_WA EQU CYREG_USB_ARB_RW4_WA
USBUART_USB__ARB_RW4_WA_MSB EQU CYREG_USB_ARB_RW4_WA_MSB
USBUART_USB__ARB_RW5_DR EQU CYREG_USB_ARB_RW5_DR
USBUART_USB__ARB_RW5_RA EQU CYREG_USB_ARB_RW5_RA
USBUART_USB__ARB_RW5_RA_MSB EQU CYREG_USB_ARB_RW5_RA_MSB
USBUART_USB__ARB_RW5_WA EQU CYREG_USB_ARB_RW5_WA
USBUART_USB__ARB_RW5_WA_MSB EQU CYREG_USB_ARB_RW5_WA_MSB
USBUART_USB__ARB_RW6_DR EQU CYREG_USB_ARB_RW6_DR
USBUART_USB__ARB_RW6_RA EQU CYREG_USB_ARB_RW6_RA
USBUART_USB__ARB_RW6_RA_MSB EQU CYREG_USB_ARB_RW6_RA_MSB
USBUART_USB__ARB_RW6_WA EQU CYREG_USB_ARB_RW6_WA
USBUART_USB__ARB_RW6_WA_MSB EQU CYREG_USB_ARB_RW6_WA_MSB
USBUART_USB__ARB_RW7_DR EQU CYREG_USB_ARB_RW7_DR
USBUART_USB__ARB_RW7_RA EQU CYREG_USB_ARB_RW7_RA
USBUART_USB__ARB_RW7_RA_MSB EQU CYREG_USB_ARB_RW7_RA_MSB
USBUART_USB__ARB_RW7_WA EQU CYREG_USB_ARB_RW7_WA
USBUART_USB__ARB_RW7_WA_MSB EQU CYREG_USB_ARB_RW7_WA_MSB
USBUART_USB__ARB_RW8_DR EQU CYREG_USB_ARB_RW8_DR
USBUART_USB__ARB_RW8_RA EQU CYREG_USB_ARB_RW8_RA
USBUART_USB__ARB_RW8_RA_MSB EQU CYREG_USB_ARB_RW8_RA_MSB
USBUART_USB__ARB_RW8_WA EQU CYREG_USB_ARB_RW8_WA
USBUART_USB__ARB_RW8_WA_MSB EQU CYREG_USB_ARB_RW8_WA_MSB
USBUART_USB__BUF_SIZE EQU CYREG_USB_BUF_SIZE
USBUART_USB__BUS_RST_CNT EQU CYREG_USB_BUS_RST_CNT
USBUART_USB__CR0 EQU CYREG_USB_CR0
USBUART_USB__CR1 EQU CYREG_USB_CR1
USBUART_USB__CWA EQU CYREG_USB_CWA
USBUART_USB__CWA_MSB EQU CYREG_USB_CWA_MSB
USBUART_USB__DMA_THRES EQU CYREG_USB_DMA_THRES
USBUART_USB__DMA_THRES_MSB EQU CYREG_USB_DMA_THRES_MSB
USBUART_USB__DYN_RECONFIG EQU CYREG_USB_DYN_RECONFIG
USBUART_USB__EP_ACTIVE EQU CYREG_USB_EP_ACTIVE
USBUART_USB__EP_TYPE EQU CYREG_USB_EP_TYPE
USBUART_USB__EP0_CNT EQU CYREG_USB_EP0_CNT
USBUART_USB__EP0_CR EQU CYREG_USB_EP0_CR
USBUART_USB__EP0_DR0 EQU CYREG_USB_EP0_DR0
USBUART_USB__EP0_DR1 EQU CYREG_USB_EP0_DR1
USBUART_USB__EP0_DR2 EQU CYREG_USB_EP0_DR2
USBUART_USB__EP0_DR3 EQU CYREG_USB_EP0_DR3
USBUART_USB__EP0_DR4 EQU CYREG_USB_EP0_DR4
USBUART_USB__EP0_DR5 EQU CYREG_USB_EP0_DR5
USBUART_USB__EP0_DR6 EQU CYREG_USB_EP0_DR6
USBUART_USB__EP0_DR7 EQU CYREG_USB_EP0_DR7
USBUART_USB__MEM_DATA EQU CYREG_USB_MEM_DATA_MBASE
USBUART_USB__PM_ACT_CFG EQU CYREG_PM_ACT_CFG5
USBUART_USB__PM_ACT_MSK EQU 0x01
USBUART_USB__PM_STBY_CFG EQU CYREG_PM_STBY_CFG5
USBUART_USB__PM_STBY_MSK EQU 0x01
USBUART_USB__SIE_EP_INT_EN EQU CYREG_USB_SIE_EP_INT_EN
USBUART_USB__SIE_EP_INT_SR EQU CYREG_USB_SIE_EP_INT_SR
USBUART_USB__SIE_EP1_CNT0 EQU CYREG_USB_SIE_EP1_CNT0
USBUART_USB__SIE_EP1_CNT1 EQU CYREG_USB_SIE_EP1_CNT1
USBUART_USB__SIE_EP1_CR0 EQU CYREG_USB_SIE_EP1_CR0
USBUART_USB__SIE_EP2_CNT0 EQU CYREG_USB_SIE_EP2_CNT0
USBUART_USB__SIE_EP2_CNT1 EQU CYREG_USB_SIE_EP2_CNT1
USBUART_USB__SIE_EP2_CR0 EQU CYREG_USB_SIE_EP2_CR0
USBUART_USB__SIE_EP3_CNT0 EQU CYREG_USB_SIE_EP3_CNT0
USBUART_USB__SIE_EP3_CNT1 EQU CYREG_USB_SIE_EP3_CNT1
USBUART_USB__SIE_EP3_CR0 EQU CYREG_USB_SIE_EP3_CR0
USBUART_USB__SIE_EP4_CNT0 EQU CYREG_USB_SIE_EP4_CNT0
USBUART_USB__SIE_EP4_CNT1 EQU CYREG_USB_SIE_EP4_CNT1
USBUART_USB__SIE_EP4_CR0 EQU CYREG_USB_SIE_EP4_CR0
USBUART_USB__SIE_EP5_CNT0 EQU CYREG_USB_SIE_EP5_CNT0
USBUART_USB__SIE_EP5_CNT1 EQU CYREG_USB_SIE_EP5_CNT1
USBUART_USB__SIE_EP5_CR0 EQU CYREG_USB_SIE_EP5_CR0
USBUART_USB__SIE_EP6_CNT0 EQU CYREG_USB_SIE_EP6_CNT0
USBUART_USB__SIE_EP6_CNT1 EQU CYREG_USB_SIE_EP6_CNT1
USBUART_USB__SIE_EP6_CR0 EQU CYREG_USB_SIE_EP6_CR0
USBUART_USB__SIE_EP7_CNT0 EQU CYREG_USB_SIE_EP7_CNT0
USBUART_USB__SIE_EP7_CNT1 EQU CYREG_USB_SIE_EP7_CNT1
USBUART_USB__SIE_EP7_CR0 EQU CYREG_USB_SIE_EP7_CR0
USBUART_USB__SIE_EP8_CNT0 EQU CYREG_USB_SIE_EP8_CNT0
USBUART_USB__SIE_EP8_CNT1 EQU CYREG_USB_SIE_EP8_CNT1
USBUART_USB__SIE_EP8_CR0 EQU CYREG_USB_SIE_EP8_CR0
USBUART_USB__SOF0 EQU CYREG_USB_SOF0
USBUART_USB__SOF1 EQU CYREG_USB_SOF1
USBUART_USB__USB_CLK_EN EQU CYREG_USB_USB_CLK_EN
USBUART_USB__USBIO_CR0 EQU CYREG_USB_USBIO_CR0
USBUART_USB__USBIO_CR1 EQU CYREG_USB_USBIO_CR1

; Miscellaneous
BCLK__BUS_CLK__HZ EQU 24000000
BCLK__BUS_CLK__KHZ EQU 24000
BCLK__BUS_CLK__MHZ EQU 24
CYDEV_CHIP_DIE_LEOPARD EQU 1
CYDEV_CHIP_DIE_PSOC4A EQU 16
CYDEV_CHIP_DIE_PSOC5LP EQU 2
CYDEV_CHIP_DIE_PSOC5TM EQU 3
CYDEV_CHIP_DIE_TMA4 EQU 4
CYDEV_CHIP_DIE_UNKNOWN EQU 0
CYDEV_CHIP_FAMILY_FM0P EQU 5
CYDEV_CHIP_FAMILY_FM3 EQU 6
CYDEV_CHIP_FAMILY_FM4 EQU 7
CYDEV_CHIP_FAMILY_PSOC3 EQU 1
CYDEV_CHIP_FAMILY_PSOC4 EQU 2
CYDEV_CHIP_FAMILY_PSOC5 EQU 3
CYDEV_CHIP_FAMILY_PSOC6 EQU 4
CYDEV_CHIP_FAMILY_UNKNOWN EQU 0
CYDEV_CHIP_FAMILY_USED EQU CYDEV_CHIP_FAMILY_PSOC5
CYDEV_CHIP_JTAG_ID EQU 0x2E123069
CYDEV_CHIP_MEMBER_3A EQU 1
CYDEV_CHIP_MEMBER_4A EQU 16
CYDEV_CHIP_MEMBER_4D EQU 12
CYDEV_CHIP_MEMBER_4E EQU 6
CYDEV_CHIP_MEMBER_4F EQU 17
CYDEV_CHIP_MEMBER_4G EQU 4
CYDEV_CHIP_MEMBER_4H EQU 15
CYDEV_CHIP_MEMBER_4I EQU 21
CYDEV_CHIP_MEMBER_4J EQU 13
CYDEV_CHIP_MEMBER_4K EQU 14
CYDEV_CHIP_MEMBER_4L EQU 20
CYDEV_CHIP_MEMBER_4M EQU 19
CYDEV_CHIP_MEMBER_4N EQU 9
CYDEV_CHIP_MEMBER_4O EQU 7
CYDEV_CHIP_MEMBER_4P EQU 18
CYDEV_CHIP_MEMBER_4Q EQU 11
CYDEV_CHIP_MEMBER_4R EQU 8
CYDEV_CHIP_MEMBER_4S EQU 10
CYDEV_CHIP_MEMBER_4U EQU 5
CYDEV_CHIP_MEMBER_5A EQU 3
CYDEV_CHIP_MEMBER_5B EQU 2
CYDEV_CHIP_MEMBER_6A EQU 22
CYDEV_CHIP_MEMBER_FM3 EQU 26
CYDEV_CHIP_MEMBER_FM4 EQU 27
CYDEV_CHIP_MEMBER_PDL_FM0P_TYPE1 EQU 23
CYDEV_CHIP_MEMBER_PDL_FM0P_TYPE2 EQU 24
CYDEV_CHIP_MEMBER_PDL_FM0P_TYPE3 EQU 25
CYDEV_CHIP_MEMBER_UNKNOWN EQU 0
CYDEV_CHIP_MEMBER_USED EQU CYDEV_CHIP_MEMBER_5B
CYDEV_CHIP_DIE_EXPECT EQU CYDEV_CHIP_MEMBER_USED
CYDEV_CHIP_DIE_ACTUAL EQU CYDEV_CHIP_DIE_EXPECT
CYDEV_CHIP_REV_LEOPARD_ES1 EQU 0
CYDEV_CHIP_REV_LEOPARD_ES2 EQU 1
CYDEV_CHIP_REV_LEOPARD_ES3 EQU 3
CYDEV_CHIP_REV_LEOPARD_PRODUCTION EQU 3
CYDEV_CHIP_REV_PSOC4A_ES0 EQU 17
CYDEV_CHIP_REV_PSOC4A_PRODUCTION EQU 17
CYDEV_CHIP_REV_PSOC5LP_ES0 EQU 0
CYDEV_CHIP_REV_PSOC5LP_PRODUCTION EQU 0
CYDEV_CHIP_REV_PSOC5TM_ES0 EQU 0
CYDEV_CHIP_REV_PSOC5TM_ES1 EQU 1
CYDEV_CHIP_REV_PSOC5TM_PRODUCTION EQU 1
CYDEV_CHIP_REV_TMA4_ES EQU 17
CYDEV_CHIP_REV_TMA4_ES2 EQU 33
CYDEV_CHIP_REV_TMA4_PRODUCTION EQU 17
CYDEV_CHIP_REVISION_3A_ES1 EQU 0
CYDEV_CHIP_REVISION_3A_ES2 EQU 1
CYDEV_CHIP_REVISION_3A_ES3 EQU 3
CYDEV_CHIP_REVISION_3A_PRODUCTION EQU 3
CYDEV_CHIP_REVISION_4A_ES0 EQU 17
CYDEV_CHIP_REVISION_4A_PRODUCTION EQU 17
CYDEV_CHIP_REVISION_4D_PRODUCTION EQU 0
CYDEV_CHIP_REVISION_4E_PRODUCTION EQU 0
CYDEV_CHIP_REVISION_4F_PRODUCTION EQU 0
CYDEV_CHIP_REVISION_4F_PRODUCTION_256DMA EQU 0
CYDEV_CHIP_REVISION_4F_PRODUCTION_256K EQU 0
CYDEV_CHIP_REVISION_4G_ES EQU 17
CYDEV_CHIP_REVISION_4G_ES2 EQU 33
CYDEV_CHIP_REVISION_4G_PRODUCTION EQU 17
CYDEV_CHIP_REVISION_4H_PRODUCTION EQU 0
CYDEV_CHIP_REVISION_4I_PRODUCTION EQU 0
CYDEV_CHIP_REVISION_4J_PRODUCTION EQU 0
CYDEV_CHIP_REVISION_4K_PRODUCTION EQU 0
CYDEV_CHIP_REVISION_4L_PRODUCTION EQU 0
CYDEV_CHIP_REVISION_4M_PRODUCTION EQU 0
CYDEV_CHIP_REVISION_4N_PRODUCTION EQU 0
CYDEV_CHIP_REVISION_4O_PRODUCTION EQU 0
CYDEV_CHIP_REVISION_4P_PRODUCTION EQU 0
CYDEV_CHIP_REVISION_4Q_PRODUCTION EQU 0
CYDEV_CHIP_REVISION_4R_PRODUCTION EQU 0
CYDEV_CHIP_REVISION_4S_PRODUCTION EQU 0
CYDEV_CHIP_REVISION_4U_PRODUCTION EQU 0
CYDEV_CHIP_REVISION_5A_ES0 EQU 0
CYDEV_CHIP_REVISION_5A_ES1 EQU 1
CYDEV_CHIP_REVISION_5A_PRODUCTION EQU 1
CYDEV_CHIP_REVISION_5B_ES0 EQU 0
CYDEV_CHIP_REVISION_5B_PRODUCTION EQU 0
CYDEV_CHIP_REVISION_6A_NO_UDB EQU 0
CYDEV_CHIP_REVISION_6A_PRODUCTION EQU 0
CYDEV_CHIP_REVISION_FM3_PRODUCTION EQU 0
CYDEV_CHIP_REVISION_FM4_PRODUCTION EQU 0
CYDEV_CHIP_REVISION_PDL_FM0P_TYPE1_PRODUCTION EQU 0
CYDEV_CHIP_REVISION_PDL_FM0P_TYPE2_PRODUCTION EQU 0
CYDEV_CHIP_REVISION_PDL_FM0P_TYPE3_PRODUCTION EQU 0
CYDEV_CHIP_REVISION_USED EQU CYDEV_CHIP_REVISION_5B_PRODUCTION
CYDEV_CHIP_REV_EXPECT EQU CYDEV_CHIP_REVISION_USED
CYDEV_CONFIG_FASTBOOT_ENABLED EQU 1
CYDEV_CONFIG_UNUSED_IO_AllowButWarn EQU 0
CYDEV_CONFIG_UNUSED_IO EQU CYDEV_CONFIG_UNUSED_IO_AllowButWarn
CYDEV_CONFIG_UNUSED_IO_AllowWithInfo EQU 1
CYDEV_CONFIG_UNUSED_IO_Disallowed EQU 2
CYDEV_CONFIGURATION_COMPRESSED EQU 1
CYDEV_CONFIGURATION_DMA EQU 0
CYDEV_CONFIGURATION_ECC EQU 1
CYDEV_CONFIGURATION_IMOENABLED EQU CYDEV_CONFIG_FASTBOOT_ENABLED
CYDEV_CONFIGURATION_MODE_COMPRESSED EQU 0
CYDEV_CONFIGURATION_MODE EQU CYDEV_CONFIGURATION_MODE_COMPRESSED
CYDEV_CONFIGURATION_MODE_DMA EQU 2
CYDEV_CONFIGURATION_MODE_UNCOMPRESSED EQU 1
CYDEV_DEBUG_ENABLE_MASK EQU 0x20
CYDEV_DEBUG_ENABLE_REGISTER EQU CYREG_MLOGIC_DEBUG
CYDEV_DEBUGGING_DPS_Disable EQU 3
CYDEV_DEBUGGING_DPS_JTAG_4 EQU 1
CYDEV_DEBUGGING_DPS_JTAG_5 EQU 0
CYDEV_DEBUGGING_DPS_SWD EQU 2
CYDEV_DEBUGGING_DPS_SWD_SWV EQU 6
CYDEV_DEBUGGING_DPS EQU CYDEV_DEBUGGING_DPS_SWD_SWV
CYDEV_DEBUGGING_ENABLE EQU 1
CYDEV_DEBUGGING_XRES EQU 0
CYDEV_DMA_CHANNELS_AVAILABLE EQU 24
CYDEV_ECC_ENABLE EQU 0
CYDEV_HEAP_SIZE EQU 0x80
CYDEV_INSTRUCT_CACHE_ENABLED EQU 1
CYDEV_INTR_RISING EQU 0x00000001
CYDEV_IS_EXPORTING_CODE EQU 0
CYDEV_IS_IMPORTING_CODE EQU 0
CYDEV_PROJ_TYPE EQU 0
CYDEV_PROJ_TYPE_BOOTLOADER EQU 1
CYDEV_PROJ_TYPE_LAUNCHER EQU 5
CYDEV_PROJ_TYPE_LOADABLE EQU 2
CYDEV_PROJ_TYPE_LOADABLEANDBOOTLOADER EQU 4
CYDEV_PROJ_TYPE_MULTIAPPBOOTLOADER EQU 3
CYDEV_PROJ_TYPE_STANDARD EQU 0
CYDEV_PROTECTION_ENABLE EQU 0
CYDEV_STACK_SIZE EQU 0x0800
CYDEV_USB_CLK_OSC_LOCKING_ENABLED_AT_PWR_UP EQU 1
CYDEV_USE_BUNDLED_CMSIS EQU 1
CYDEV_VARIABLE_VDDA EQU 0
CYDEV_VDDA_MV EQU 5000
CYDEV_VDDD_MV EQU 5000
CYDEV_VDDIO0_MV EQU 5000
CYDEV_VDDIO1_MV EQU 5000
CYDEV_VDDIO2_MV EQU 5000
CYDEV_VDDIO3_MV EQU 5000
CYDEV_VIO0_MV EQU 5000
CYDEV_VIO1_MV EQU 5000
CYDEV_VIO2_MV EQU 5000
CYDEV_VIO3_MV EQU 5000
CYIPBLOCK_ARM_CM3_VERSION EQU 0
CYIPBLOCK_P3_ANAIF_VERSION EQU 0
CYIPBLOCK_P3_CAN_VERSION EQU 0
CYIPBLOCK_P3_CAPSENSE_VERSION EQU 0
CYIPBLOCK_P3_COMP_VERSION EQU 0
CYIPBLOCK_P3_DECIMATOR_VERSION EQU 0
CYIPBLOCK_P3_DFB_VERSION EQU 0
CYIPBLOCK_P3_DMA_VERSION EQU 0
CYIPBLOCK_P3_DRQ_VERSION EQU 0
CYIPBLOCK_P3_DSM_VERSION EQU 0
CYIPBLOCK_P3_EMIF_VERSION EQU 0
CYIPBLOCK_P3_I2C_VERSION EQU 0
CYIPBLOCK_P3_LCD_VERSION EQU 0
CYIPBLOCK_P3_LPF_VERSION EQU 0
CYIPBLOCK_P3_OPAMP_VERSION EQU 0
CYIPBLOCK_P3_PM_VERSION EQU 0
CYIPBLOCK_P3_SCCT_VERSION EQU 0
CYIPBLOCK_P3_TIMER_VERSION EQU 0
CYIPBLOCK_P3_USB_VERSION EQU 0
CYIPBLOCK_P3_VIDAC_VERSION EQU 0
CYIPBLOCK_P3_VREF_VERSION EQU 0
CYIPBLOCK_S8_GPIO_VERSION EQU 0
CYIPBLOCK_S8_IRQ_VERSION EQU 0
CYIPBLOCK_S8_SAR_VERSION EQU 0
CYIPBLOCK_S8_SIO_VERSION EQU 0
CYIPBLOCK_S8_UDB_VERSION EQU 0
DMA_CHANNELS_USED__MASK0 EQU 0x00000000
CYDEV_BOOTLOADER_ENABLE EQU 0
    ENDIF
    END
